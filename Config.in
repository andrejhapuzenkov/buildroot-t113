## Config.in
```kconfig
source "$BR2_EXTERNAL_K3D_PATH/package/klipper3d/Config.in"
source "$BR2_EXTERNAL_K3D_PATH/package/moonraker/Config.in"
source "$BR2_EXTERNAL_K3D_PATH/package/python-libnacl/Config.in"
source "$BR2_EXTERNAL_K3D_PATH/package/python-ldap3/Config.in"
source "$BR2_EXTERNAL_K3D_PATH/package/python-apprise/Config.in"
source "$BR2_EXTERNAL_K3D_PATH/package/python-inotify-simple/Config.in"
source "$BR2_EXTERNAL_K3D_PATH/package/python-importlib-metadata/Config.in"
source "$BR2_EXTERNAL_K3D_PATH/package/python-streaming-form-data/Config.in"
source "$BR2_EXTERNAL_K3D_PATH/package/python-preprocess-cancellation/Config.in"
source "$BR2_EXTERNAL_K3D_PATH/package/python-smart-open/Config.in"
source "$BR2_EXTERNAL_K3D_PATH/package/python-virtualenv/Config.in"
#source "$BR2_EXTERNAL_K3D_PATH/package/python-sqlite3py/Config.in"
source "$BR2_EXTERNAL_K3D_PATH/package/mainsail/Config.in"
```

## package/mainsail/Config.in
```kconfig
config BR2_PACKAGE_MAINSAIL
	bool "mainsail"
	
	select BR2_PACKAGE_NGINX

	help
	  A modern and responsive user interface for Klipper.
	  Control and monitor your printer from everywhere, from any device.
	  https://github.com/mainsail-crew/mainsail.git
	  
```

## package/moonraker/Config.in
```kconfig
config BR2_PACKAGE_MOONRAKER
	bool "moonraker"
	
	select BR2_PACKAGE_SSLH
	select BR2_PACKAGE_LIBSSH
	select BR2_PACKAGE_LIBSSH2
	select BR2_PACKAGE_LUA
#	select BR2_PACKAGE_HAS_LUAINTERPRETER
#	select BR2_STATIC_LIBS
	select BR2_PACKAGE_LSQLITE3
	select BR2_PACKAGE_SQLITE
#	select BR2_PACKAGE_PYTHON_SQLITE3PY
	select BR2_PACKAGE_PYTHON3_SQLITE
	select BR2_PACKAGE_NGINX
	select BR2_PACKAGE_PYTHON_WRAPT
	select BR2_PACKAGE_PYTHON_SERIAL_ASYNCIO
	select BR2_PACKAGE_PYTHON_PILLOW
	select BR2_PACKAGE_PYTHON_DISTRO
	select BR2_PACKAGE_PYTHON_PAHO_MQTT
	select BR2_PACKAGE_PYTHON_ZEROCONF
	select BR2_PACKAGE_PYTHON_ZEROCONF
	select BR2_PACKAGE_PYTHON_DBUS_FAST
	select BR2_PACKAGE_PYTHON_DBUS_NEXT
	select BR2_PACKAGE_PYTHON_PERIPHERY
	select BR2_PACKAGE_PYTHON_LIBNACL
	select BR2_PACKAGE_PYTHON_LDAP3
	select BR2_PACKAGE_PYTHON_INOTIFY_SIMPLE
	select BR2_PACKAGE_PYTHON_IMPORTLIB_METADATA
	select BR2_PACKAGE_PYTHON_STREAMING_FORM_DATA
	select BR2_PACKAGE_PYTHON_PREPROCESS_CANCELLATION
	select BR2_PACKAGE_PYTHON_APPRISE
	select BR2_PACKAGE_PYTHON_VIRTUALENV
	select BR2_PACKAGE_IW
	select BR2_PACKAGE_OPENJPEG
	select BR2_PACKAGE_LIBGPIOD
	select BR2_PACKAGE_LIBCURL
	select BR2_PACKAGE_OPENSSL
	select BR2_PACKAGE_LIBMDBX
	select BR2_PACKAGE_LMDB
	select BR2_PACKAGE_LIBSODIUM
	select BR2_PACKAGE_ZLIB
	select BR2_PACKAGE_LIBPAGEKITE
	select BR2_PACKAGE_PYTHON_MSGPACK
	select BR2_PACKAGE_PYTHON_UVLOOP
	select BR2_PACKAGE_PYTHON_SMART_OPEN
#	select BR2_PACKAGE_PYTHON_BABEL
#	select BR2_PACKAGE_PYTHON_CAN
#	select BR2_PACKAGE_PYTHON_MARKUPSAFE
#	select BR2_PACKAGE_STM32FLASH
#	select BR2_PACKAGE_BINUTILS
#	select BR2_PACKAGE_BINUTILS_TARGET
#	select BR2_PACKAGE_PKGCONF

	help
	  Moonraker - API Web Server for Klipper.
	  
	  https://github.com/Arksine/moonraker
	  
```

## package/python-apprise/Config.in
```kconfig
config BR2_PACKAGE_PYTHON_APPRISE
	bool "python-apprise"
	
	help

	  https://pypi.org/project/apprise/
```

## package/python-importlib-metadata/Config.in
```kconfig
config BR2_PACKAGE_PYTHON_IMPORTLIB_METADATA
	bool "python-importlib-metadata"
	help
	  
	  https://pypi.org/project/importlib-metadata/
```

## package/python-inotify-simple/Config.in
```kconfig
config BR2_PACKAGE_PYTHON_INOTIFY_SIMPLE
	bool "python-inotify-simple"
	help
	  
	  https://pypi.org/project/inotify-simple/
```

## package/python-ldap3/Config.in
```kconfig
config BR2_PACKAGE_PYTHON_LDAP3
	bool "python-ldap3"
	help
	  
	  https://pypi.org/project/ldap3/
```

## package/python-preprocess-cancellation/Config.in
```kconfig
config BR2_PACKAGE_PYTHON_PREPROCESS_CANCELLATION
	bool "python-preprocess-cancellation"
	help
	  
	  https://pypi.org/project/preprocess_cancellation/
```

## package/python-smart-open/Config.in
```kconfig
config BR2_PACKAGE_PYTHON_SMART_OPEN
	bool "python-smart-open"
	
	help

	  https://pypi.org/project/smart-open/
```

## package/python-sqlite3py/Config.in
```kconfig
config BR2_PACKAGE_PYTHON_SQLITE3PY
	bool "python-sqlite3py"
	help
	  
	  https://pypi.org/project/sqlite3py/
```

## package/python-streaming-form-data/Config.in
```kconfig
config BR2_PACKAGE_PYTHON_STREAMING_FORM_DATA
	bool "python-streaming-form-data"
	help
	  
	  https://pypi.org/project/streaming-form-data/
```

## package/python-virtualenv/Config.in
```kconfig
config BR2_PACKAGE_PYTHON_VIRTUALENV
	bool "python-virtualenv"
	
#	select BR2_PACKAGE_PYTHON_HATCH_VCS 
	
	help
	  
	  https://pypi.org/project/virtualenv/
```
